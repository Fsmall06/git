#include "lcd_st7789.h"

#include <stddef.h>
#include <stdint.h>

/* ============================== 5x7 基础 ASCII 字库 ==============================
 *
 * 说明：
 *     1. 每个字符由 7 个字节组成，每个字节低 5bit 表示一行像素。
 *     2. bit4 对应最左侧像素，bit0 对应最右侧像素。
 *     3. font16/font24 通过不同缩放参数复用这套点阵，便于后续替换为更完整字体。
 */

static const uint8_t s_font5x7_space[LCD_FONT_BASE_HEIGHT] = {
    0x00, 0x00, 0x00, 0x00, 0x00, 0x00, 0x00,
};

static const uint8_t s_font5x7_digits[10][LCD_FONT_BASE_HEIGHT] = {
    {0x0E, 0x11, 0x13, 0x15, 0x19, 0x11, 0x0E}, /* 0 */
    {0x04, 0x0C, 0x04, 0x04, 0x04, 0x04, 0x0E}, /* 1 */
    {0x0E, 0x11, 0x01, 0x02, 0x04, 0x08, 0x1F}, /* 2 */
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    {0x0E, 0x11, 0x11, 0x0F, 0x01, 0x02, 0x0C}, /* 9 */
};

static const uint8_t s_font5x7_uppercase[26][LCD_FONT_BASE_HEIGHT] = {
    {0x0E, 0x11, 0x11, 0x1F, 0x11, 0x11, 0x11}, /* A */
    {0x1E, 0x11, 0x11, 0x1E, 0x11, 0x11, 0x1E}, /* B */
    {0x0E, 0x11, 0x10, 0x10, 0x10, 0x11, 0x0E}, /* C */
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    {0x1F, 0x01, 0x02, 0x04, 0x08, 0x10, 0x1F}, /* Z */
};

static const uint8_t s_font5x7_colon[LCD_FONT_BASE_HEIGHT] = {
    0x00, 0x04, 0x04, 0x00, 0x04, 0x04, 0x00,
};

static const uint8_t s_font5x7_dot[LCD_FONT_BASE_HEIGHT] = {
    0x00, 0x00, 0x00, 0x00, 0x00, 0x0C, 0x0C,
};

static const uint8_t s_font5x7_minus[LCD_FONT_BASE_HEIGHT] = {
    0x00, 0x00, 0x00, 0x1F, 0x00, 0x00, 0x00,
};

static const uint8_t s_font5x7_slash[LCD_FONT_BASE_HEIGHT] = {
    0x01, 0x02, 0x02, 0x04, 0x08, 0x08, 0x10,
};

static const uint8_t s_font5x7_percent[LCD_FONT_BASE_HEIGHT] = {
    0x18, 0x19, 0x02, 0x04, 0x08, 0x13, 0x03,
};

static const uint8_t s_font5x7_degree[LCD_FONT_BASE_HEIGHT] = {
    0x0C, 0x12, 0x12, 0x0C, 0x00, 0x00, 0x00,
};

static const uint8_t s_font5x7_question[LCD_FONT_BASE_HEIGHT] = {
    0x0E, 0x11, 0x01, 0x02, 0x04, 0x00, 0x04,
};

/* lcd_font_get_basic_5x7_glyph：获取基础 5x7 ASCII 点阵。
 *
 * 参数：
 *     ch：需要显示的 ASCII 字符。
 *
 * 返回：
 *     点阵数组地址；未知字符返回空格点阵，避免屏幕显示乱码。
 *
 * 调用方法：
 *     const uint8_t *glyph = lcd_font_get_basic_5x7_glyph('T');
 */
const uint8_t *lcd_font_get_basic_5x7_glyph(char ch)
{
    if ((ch >= '0') && (ch <= '9'))
    {
        return s_font5x7_digits[(size_t)(ch - '0')];
    }

    if ((ch >= 'A') && (ch <= 'Z'))
    {
        return s_font5x7_uppercase[(size_t)(ch - 'A')];
    }

    if ((ch >= 'a') && (ch <= 'z'))
    {
        return s_font5x7_uppercase[(size_t)(ch - 'a')];
    }

    switch (ch)
    {
        case ' ':
            return s_font5x7_space;
        case ':':
            return s_font5x7_colon;
        case '.':
            return s_font5x7_dot;
        case '-':
            return s_font5x7_minus;
        case '/':
            return s_font5x7_slash;
        case '%':
            return s_font5x7_percent;
        case '^':
            return s_font5x7_degree;
        case '?':
            return s_font5x7_question;
        default:
            return s_font5x7_space;
    }
}

/* g_lcd_font16：8x16 ASCII 字体对象。
 *
 * 功能：
 *     用于 Dashboard 标签和状态文本；底层绘制函数会根据 scale/offset 放大 5x7 点阵。
 *
 * 调用方法：
 *     lcd_st7789_draw_string(8, 8, "TEMP", &g_lcd_font16, LCD_COLOR_WHITE, LCD_COLOR_BLACK);
 */
const lcd_font_t g_lcd_font16 = {
    .width = LCD_FONT16_WIDTH,
    .height = LCD_FONT16_HEIGHT,
    .base_width = LCD_FONT_BASE_WIDTH,
    .base_height = LCD_FONT_BASE_HEIGHT,
    .scale_x = LCD_FONT16_SCALE_X,
    .scale_y = LCD_FONT16_SCALE_Y,
    .offset_x = LCD_FONT16_OFFSET_X,
    .offset_y = LCD_FONT16_OFFSET_Y,
    .get_glyph = lcd_font_get_basic_5x7_glyph,
};
